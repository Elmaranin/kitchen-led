## main/Kconfig.projbuild
```kconfig
menu "Kitchen LED controller"

menu "Wi-Fi"

config KITCHEN_WIFI_SSID
    string "Station SSID"
    default ""
    help
        The controller starts the fallback AP immediately if this value is empty.
        The SSID can contain at most 32 bytes.

config KITCHEN_WIFI_PASSWORD
    string "Station password"
    default ""
    help
        Leave this value empty for an open network.
        Password-protected networks must support WPA2.

config KITCHEN_WIFI_TIMEOUT_SECONDS
    int "Station connection timeout in seconds"
    default 30
    range 5 300
    help
        The controller starts the fallback AP if it cannot obtain an IP address
        within this interval. The same timeout applies after a connection loss.

config KITCHEN_MDNS_HOSTNAME
    string "mDNS hostname"
    default "kitchen-led"
    help
        Use a hostname without the .local suffix, up to 63 characters.
        Use letters, digits, and internal hyphens. Each controller needs a unique name.

config KITCHEN_AP_PASSWORD
    string "Fallback AP password"
    default "kitchen-led-setup"
    help
        The password must contain 8 to 63 bytes.
        The AP name is kitchen-led- followed by the last three MAC address bytes.

endmenu

config KITCHEN_TEST_EFFECT
    bool "Enable LED effects and controller controls"
    default y
    help
        The Controller tab selects grid effects, speed, brightness, and test colors.
        The controller starts with a dim rainbow wave.
        Set each line's LED count to match the connected test strip.
        The effect does not control the relay.

choice KITCHEN_LED_COLOR_ORDER
    prompt "LED color byte order"
    default KITCHEN_LED_COLOR_ORDER_RGB
    help
        Select the order expected by the connected strips.
        This setting applies to all four lines.

config KITCHEN_LED_COLOR_ORDER_RGB
    bool "RGB"

config KITCHEN_LED_COLOR_ORDER_GRB
    bool "GRB"

endchoice

config KITCHEN_LINE_1_SWAP_RG
    bool "Swap red and green on right up"
    default y

config KITCHEN_LINE_2_SWAP_RG
    bool "Swap red and green on right down"
    default y

config KITCHEN_LINE_3_SWAP_RG
    bool "Swap red and green on left down"
    default y

config KITCHEN_LINE_4_SWAP_RG
    bool "Swap red and green on left up"
    default y

config KITCHEN_LINE_1_GPIO
    int "Right up GPIO"
    default 4
    range 4 13

config KITCHEN_LINE_2_GPIO
    int "Right down GPIO"
    default 5
    range 4 13

config KITCHEN_LINE_3_GPIO
    int "Left down GPIO"
    default 12
    range 4 13

config KITCHEN_LINE_4_GPIO
    int "Left up GPIO"
    default 13
    range 4 13

config KITCHEN_LINE_1_LEDS
    int "Right up LED count"
    default 36
    range 1 144

config KITCHEN_LINE_2_LEDS
    int "Right down LED count"
    default 36
    range 1 144

config KITCHEN_LINE_3_LEDS
    int "Left down LED count"
    default 36
    range 1 144

config KITCHEN_LINE_4_LEDS
    int "Left up LED count"
    default 36
    range 1 144

endmenu
```

## sdkconfig.defaults
```kconfig
CONFIG_ESP8266_DEFAULT_CPU_FREQ_80=y
# CONFIG_PM_ENABLE is not set
CONFIG_ESPTOOLPY_FLASHSIZE_4MB=y
CONFIG_PARTITION_TABLE_TWO_OTA=y
CONFIG_HTTPD_MAX_REQ_HDR_LEN=1024
CONFIG_ENABLE_MDNS=y
CONFIG_KITCHEN_LED_COLOR_ORDER_RGB=y
CONFIG_KITCHEN_LINE_1_LEDS=36
CONFIG_KITCHEN_LINE_2_LEDS=36
CONFIG_KITCHEN_LINE_3_LEDS=36
CONFIG_KITCHEN_LINE_4_LEDS=36

CONFIG_KITCHEN_LINE_1_SWAP_RG=y
CONFIG_KITCHEN_LINE_2_SWAP_RG=y
CONFIG_KITCHEN_LINE_3_SWAP_RG=y
CONFIG_KITCHEN_LINE_4_SWAP_RG=y
```
